AUTOSAR XML (schema 00049)
package /vwg/applications/@EXECUTABLE_NAME@/deployment/Default
  process to machine mapping set ProcessToMachineMapping
    process to machine mapping ProcessToMachineMapping: machine=Default, process=@EXECUTABLE_NAME@_Default
