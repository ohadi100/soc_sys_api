AUTOSAR XML (schema 00049)
package /vwg/applications/@EXECUTABLE_NAME@/deployment/Default
  process @EXECUTABLE_NAME@_Default
  dlt log channel to process mapping @EXECUTABLE_NAME@_log_channel: dlt-log-channel=@EXECUTABLE_NAME@_log_channel, process=@EXECUTABLE_NAME@_Default
