AUTOSAR XML (schema 00049)
package /vwg/applications/@EXECUTABLE_NAME@/deployment/Default
  process @EXECUTABLE_NAME@_Default: design=@EXECUTABLE_NAME@ProcessDesign, executable=@EXECUTABLE_NAME@, state-dependent-startup-config{function-group-state=[MachineFG.Running, MachineFG.RunLevelS0, MachineFG.RunLevelS1, MachineFG.RunLevelS2], startup-config=StartupConfig}
    process state machine ModeDeclarationGroupPrototype: type=ApplicationStates
  startup config set StartupConfigs
    startup config StartupConfig: process-argument=@PROCESS_ARG@, scheduling-policy=SCHED_RR, scheduling-priority=15
