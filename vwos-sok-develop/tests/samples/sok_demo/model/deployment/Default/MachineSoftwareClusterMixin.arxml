AUTOSAR XML (schema 00049)
package /vwg/machines/Default
  software cluster DefaultRootSoftwareCluster: category=PLATFORM_CORE, contained-process=@EXECUTABLE_NAME@_Default, version=1.0.0
