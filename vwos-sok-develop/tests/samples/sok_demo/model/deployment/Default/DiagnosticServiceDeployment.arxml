AUTOSAR XML (schema 00049)
package /vwg/applications/@EXECUTABLE_NAME@/deployment/Default/ServiceInterfaceMapping
  provided user defined service instance DiagnosticDataManagment_ProvidedServiceInstance: service-interface-deployment=DiagnosticDataManagement_IPC
  required user defined service instance DiagnosticDataManagment_RequiredServiceInstance: service-interface-deployment=DiagnosticDataManagement_IPC
  service instance to port prototype mapping DiagnosticDataManagement_PServInstMapping: port-prototype=@EXECUTABLE_NAME@RootSWC.PDiagnosticDataManagement, process-design=@EXECUTABLE_NAME@ProcessDesign, process=@EXECUTABLE_NAME@Process_Default, service-instance=DiagnosticDataManagment_ProvidedServiceInstance
  service instance to port prototype mapping DiagnosticDataManagement_RServInstMapping: port-prototype=@EXECUTABLE_NAME@RootSWC.RDiagnosticDataManagement, process-design=@EXECUTABLE_NAME@ProcessDesign, process=@EXECUTABLE_NAME@_Default, service-instance=DiagnosticDataManagment_RequiredServiceInstance
  user defined service instance to machine mapping DiagnosticDataManagement_PServInstToMachineMap: communication-connector=EthernetCommunicationConnector, service-instance=DiagnosticDataManagment_ProvidedServiceInstance
  user defined service instance to machine mapping DiagnosticDataManagement_RServInstToMachineMap: communication-connector=EthernetCommunicationConnector, service-instance=DiagnosticDataManagment_RequiredServiceInstance
  required user defined service instance DiagnosticRegistration_RequiredServiceInstance: service-interface-deployment=DiagnosticRegistration_IPC
  service instance to port prototype mapping DiagnosticRegistration_RServInstMapping: port-prototype=@EXECUTABLE_NAME@RootSWC.RDiagnosticRegistration, process-design=@EXECUTABLE_NAME@ProcessDesign, process=@EXECUTABLE_NAME@_Default, service-instance=DiagnosticRegistration_RequiredServiceInstance
  user defined service instance to machine mapping DiagnosticRegistration_RServInstToMachineMap: communication-connector=EthernetCommunicationConnector, service-instance=DiagnosticRegistration_RequiredServiceInstance
