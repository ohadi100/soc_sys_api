AUTOSAR XML (schema 00049)
package /vwg/machines/Default
  machine Default
    module-instantiations:
      log and trace instantiation LogAndTraceInstantiation
        dlt log channel @EXECUTABLE_NAME@_log_channel: application-description=@LOG_DESCRIPTION@, application-id=@LOG_CTX_ID@, context-id=default, log-trace-default-log-level=DEBUG
